/*
  Ninebot MAX G30 BLE Telemetry v6 - callback-safe
  =================================
  ESP32-C3 / Arduino ESP32 BLE (BLEDevice.h)

  Erkenntnisse aus dem Hardware-Test:
  - Service: 6e400001-b5a3-f393-e0a9-e50e24dcca9e
  - Write:   6e400002-b5a3-f393-e0a9-e50e24dcca9e
  - Notify:  6e400003-b5a3-f393-e0a9-e50e24dcca9e
  - Dieses Dashboard antwortet nur zuverlaessig bei BLE Write WITH response.
  - NinebotCrypto (legacy chained crypto) ist bestaetigt.
  - 0x5B-Antwort: BLE random/key + 14-byte Seriennummer.

  Ablauf:
  1) BLE verbinden + Notify aktivieren
  2) NinebotCrypto INIT 0x5B
  3) BLE-Random + Seriennummer aus Antwort uebernehmen
  4) PING/AUTH 0x5C mit 16 Byte App-Key
  5) Power-Taste bestaetigen, bis 0x5C01 empfangen wird
  6) PAIR 0x5D mit Seriennummer
  7) Nach erfolgreicher Authentifizierung NUR READ-ONLY:
       BMS 0x32 -> Battery %
       ESC 0x26 -> Speed
       BMS 0x33/34/35 -> Current/Voltage/Temperature
       ESC 0x29/0x2A -> Odometer

  Hinweis:
  Die Authentifizierung 0x5C/0x5D betrifft den BLE-Pairing/Auth-Zustand.
  Der Sketch schreibt KEINE Fahrparameter / Speed-Limits / ESC-Settings.
*/

#include <Arduino.h>
#include <math.h>
#include "ninebot_telemetry.h"

#include <BLEDevice.h>
#include <BLEUtils.h>
#include <BLEScan.h>
#include <BLEAdvertisedDevice.h>
#include <Preferences.h>

#include <mbedtls/aes.h>
#include <mbedtls/sha1.h>

#include <cstring>
#include <string>

// ============================================================
// BLE UUIDs
// ============================================================

static BLEUUID SVC_UUID   ("6e400001-b5a3-f393-e0a9-e50e24dcca9e");
static BLEUUID CHR_WRITE  ("6e400002-b5a3-f393-e0a9-e50e24dcca9e");
static BLEUUID CHR_NOTIFY ("6e400003-b5a3-f393-e0a9-e50e24dcca9e");
static BLEUUID CCCD_UUID  ((uint16_t)0x2902);

// ============================================================
// Ninebot IDs / commands
// ============================================================

static const uint8_t DEV_ESC   = 0x20;
static const uint8_t DEV_BLE   = 0x21;
static const uint8_t DEV_BATT  = 0x22;
static const uint8_t DEV_PHONE = 0x3E;

static const uint8_t CMD_READ     = 0x01;
static const uint8_t CMD_WRITE    = 0x03;
static const uint8_t CMD_READ_ACK = 0x04;

static const uint8_t CMD_INIT = 0x5B;
static const uint8_t CMD_PING = 0x5C;
static const uint8_t CMD_PAIR = 0x5D;

// Read-only G30 registers.
// Controller:
static const uint8_t REG_MODE     = 0x1F; // current mode: 0=Normal/Drive, 1=Eco, 2=Sport
static const uint8_t REG_SPEED    = 0x26; // current speed, 0.1 km/h
static const uint8_t REG_DPC      = 0x76; // CFW switchable DPC register: 0=off, 1=on
static const uint8_t REG_ODO_LO   = 0x29; // total mileage low 16 bit, metres
static const uint8_t REG_ODO_HI   = 0x2A; // total mileage high 16 bit
// BMS:
static const uint8_t REG_BAT_PCT  = 0x32; // battery percent
static const uint8_t REG_BAT_CUR  = 0x33; // signed current, 0.01 A
static const uint8_t REG_BAT_VOLT = 0x34; // voltage, 0.01 V
static const uint8_t REG_BAT_TEMP = 0x35; // two temperature bytes, each offset +20

// ============================================================
// NinebotCrypto constants/state
// ============================================================

static const uint8_t FW_DATA[16] = {
  0x97, 0xCF, 0xB8, 0x02,
  0x84, 0x41, 0x43, 0xDE,
  0x56, 0x00, 0x2B, 0x3B,
  0x34, 0x78, 0x0A, 0x5D
};

uint8_t scooterName16[16] = {0};
uint8_t randomBleData[16] = {0};
uint8_t randomAppData[16] = {0};
uint8_t shaKey[16] = {0};

uint32_t msgIt = 0;

uint8_t scooterSerial[14] = {0};
bool haveInitData = false;
bool haveAppKey = false;

// Persistent auth state in ESP32 NVS. The App-Key is only reused for the
// exact scooter serial number that successfully completed 0x5D pairing.
static const char* AUTH_NVS_NS = "nb_auth";
static bool usingStoredAppKey = false;

// v7.11: optional REAL Segway app binding key (<SERIAL>_decrypt).
// This is different from the random key we generate during normal 0x5C pairing.
// With the real app key the official-app style flow is:
//   0x5B INIT -> set SHA1(APP_KEY || BLE_KEY) -> 0x5D(serial)
// No 0x5C and therefore no power-button confirmation.
static const char* SEGWAY_KEY_NVS_NS = "nb_segway";
static uint8_t segwayAppKey[16] = {0};
static bool haveSegwayAppKey = false;
static bool directSegwayAuth = false;
// v7.14: a key generated by THIS dashboard and accepted by a successful
// button pairing is also a bound client credential. On later boots we try
// the official-app style reconnect: INIT -> SHA1(APP_KEY||BLE_KEY) -> PAIR,
// with no new PING and therefore no power-button confirmation.
static bool directStoredAuth = false;
static bool storedKeyRejectedThisBoot = false;
static bool segwayKeyRejectedThisBoot = false;
static uint8_t pairRetryCount = 0;

// v7.10: keep packet/telemetry chatter off during normal riding. At a 100 ms
// scheduler cadence, Serial output can become a measurable bottleneck.
static const bool NB_PACKET_DEBUG = false;
static const bool NB_TELEMETRY_DEBUG = false;

// Forward declaration: debug helper is implemented below.
void dumpHex(const char* prefix, const uint8_t* data, size_t len);

static bool loadStoredAppKeyForScooter() {
  Preferences prefs;
  if (!prefs.begin(AUTH_NVS_NS, true)) {
    Serial.println("[AUTH-NVS] NVS read open failed.");
    return false;
  }

  const size_t serialLen = prefs.getBytesLength("serial");
  const size_t keyLen = prefs.getBytesLength("appkey");

  if (serialLen != sizeof(scooterSerial) || keyLen != sizeof(randomAppData)) {
    prefs.end();
    Serial.println("[AUTH-NVS] Kein gueltiger gespeicherter Pairing-Key.");
    return false;
  }

  uint8_t savedSerial[sizeof(scooterSerial)] = {0};
  uint8_t savedKey[sizeof(randomAppData)] = {0};
  prefs.getBytes("serial", savedSerial, sizeof(savedSerial));
  prefs.getBytes("appkey", savedKey, sizeof(savedKey));
  prefs.end();

  if (memcmp(savedSerial, scooterSerial, sizeof(scooterSerial)) != 0) {
    Serial.println("[AUTH-NVS] Gespeicherter Key gehoert zu einem anderen Scooter.");
    return false;
  }

  memcpy(randomAppData, savedKey, sizeof(randomAppData));
  haveAppKey = true;
  usingStoredAppKey = true;

  Serial.println("[AUTH-NVS] Gespeicherten gebundenen Dashboard-Key geladen.");
  return true;
}

static void saveStoredAppKeyForScooter() {
  if (!haveInitData || !haveAppKey) return;

  Preferences prefs;
  if (!prefs.begin(AUTH_NVS_NS, false)) {
    Serial.println("[AUTH-NVS] NVS write open failed.");
    return;
  }

  const size_t w1 = prefs.putBytes("serial", scooterSerial, sizeof(scooterSerial));
  const size_t w2 = prefs.putBytes("appkey", randomAppData, sizeof(randomAppData));
  prefs.end();

  if (w1 == sizeof(scooterSerial) && w2 == sizeof(randomAppData)) {
    Serial.println("[AUTH-NVS] Pairing-Key dauerhaft gespeichert.");
  } else {
    Serial.println("[AUTH-NVS] WARN: Pairing-Key konnte nicht vollstaendig gespeichert werden.");
  }
}

static void clearStoredAppKeyForScooter() {
  Preferences prefs;
  if (prefs.begin(AUTH_NVS_NS, false)) {
    prefs.clear();
    prefs.end();
  }
  usingStoredAppKey = false;
  directStoredAuth = false;
  Serial.println("[AUTH-NVS] Gespeicherten Dashboard-Key geloescht; naechste Session nutzt Button-Pairing.");
}


static bool hexNibble(char c, uint8_t& out) {
  if (c >= '0' && c <= '9') { out = (uint8_t)(c - '0'); return true; }
  if (c >= 'a' && c <= 'f') { out = (uint8_t)(10 + c - 'a'); return true; }
  if (c >= 'A' && c <= 'F') { out = (uint8_t)(10 + c - 'A'); return true; }
  return false;
}

static bool loadSegwayAppKey() {
  Preferences prefs;
  if (!prefs.begin(SEGWAY_KEY_NVS_NS, true)) return false;
  const size_t n = prefs.getBytesLength("appkey");
  if (n != sizeof(segwayAppKey)) { prefs.end(); return false; }
  prefs.getBytes("appkey", segwayAppKey, sizeof(segwayAppKey));
  prefs.end();
  haveSegwayAppKey = true;
  return true;
}

bool ninebotTelemetrySetSegwayAppKeyHex(const char* hex32) {
  if (!hex32) return false;
  while (*hex32 == ' ' || *hex32 == '\t') ++hex32;
  if (strlen(hex32) != 32) return false;

  uint8_t tmp[16];
  for (size_t i = 0; i < 16; ++i) {
    uint8_t hi, lo;
    if (!hexNibble(hex32[i * 2], hi) || !hexNibble(hex32[i * 2 + 1], lo)) return false;
    tmp[i] = (uint8_t)((hi << 4) | lo);
  }

  Preferences prefs;
  if (!prefs.begin(SEGWAY_KEY_NVS_NS, false)) return false;
  const size_t n = prefs.putBytes("appkey", tmp, sizeof(tmp));
  prefs.end();
  if (n != sizeof(tmp)) return false;

  memcpy(segwayAppKey, tmp, sizeof(tmp));
  haveSegwayAppKey = true;
  segwayKeyRejectedThisBoot = false;
  Serial.println("[AUTH-APP] Segway-App-Key gespeichert. Wird beim naechsten BLE-Connect benutzt.");
  return true;
}

void ninebotTelemetryClearSegwayAppKey() {
  Preferences prefs;
  if (prefs.begin(SEGWAY_KEY_NVS_NS, false)) {
    prefs.clear();
    prefs.end();
  }
  memset(segwayAppKey, 0, sizeof(segwayAppKey));
  haveSegwayAppKey = false;
  directSegwayAuth = false;
  segwayKeyRejectedThisBoot = false;
  Serial.println("[AUTH-APP] Gespeicherten Segway-App-Key geloescht.");
}

bool ninebotTelemetryHasSegwayAppKey() {
  return haveSegwayAppKey;
}

// ============================================================
// AutoConnect target
// ============================================================

// Bind AutoConnect to the exact advertised Ninebot name only after a successful
// authenticated READY state. This avoids attaching to a neighbour's scooter while
// still tolerating a BLE address that may change across power cycles.
static const char* TARGET_NVS_NS = "nb_target";
static String boundScooterName;

static void loadBoundScooterTarget() {
  Preferences prefs;
  boundScooterName = "";
  if (!prefs.begin(TARGET_NVS_NS, true)) return;
  boundScooterName = prefs.getString("name", "");
  prefs.end();
}

static void saveBoundScooterTargetName(const char* name) {
  if (!name || !name[0]) return;
  if (boundScooterName == name) return;

  Preferences prefs;
  if (!prefs.begin(TARGET_NVS_NS, false)) return;
  size_t written = prefs.putString("name", name);
  prefs.end();

  if (written > 0) {
    boundScooterName = name;
    Serial.print("[AUTOCONNECT] Scooter als Ziel gespeichert: ");
    Serial.println(boundScooterName);
  }
}

void ninebotTelemetryClearAutoConnectTarget() {
  Preferences prefs;
  if (prefs.begin(TARGET_NVS_NS, false)) {
    prefs.clear();
    prefs.end();
  }
  boundScooterName = "";
  Serial.println("[AUTOCONNECT] Zielbindung geloescht. Naechster passende NBScooter wird akzeptiert.");
}

bool ninebotTelemetryHasAutoConnectTarget() {
  return boundScooterName.length() > 0;
}

const char* ninebotTelemetryAutoConnectTarget() {
  return boundScooterName.c_str();
}

// ============================================================
// BLE state
// ============================================================

BLEAdvertisedDevice* foundDevice = nullptr;
BLEClient* pClient = nullptr;
BLERemoteCharacteristic* pWriteChar = nullptr;
BLERemoteCharacteristic* pNotifyChar = nullptr;

volatile bool doConnect = false;
volatile bool isConnected = false;
volatile bool scanRunning = false;

// Reconnect lifecycle. Destroy BLE client objects only outside BLE callbacks.
// Empty scans are normal when the scooter is powered off and must never trigger
// an ESP restart. Keep only deferred cleanup plus a short settle delay.
volatile bool clientCleanupPending = false;
volatile bool everConnectedThisBoot = false;
volatile bool scanFoundThisRound = false;
volatile uint32_t disconnectedAtMs = 0;
static constexpr uint32_t RECONNECT_SETTLE_MS = 1500;

// ============================================================
// Protocol state
// ============================================================

enum AuthState {
  AUTH_IDLE,
  AUTH_WAIT_INIT,
  AUTH_WAIT_PING,
  AUTH_WAIT_PAIR,
  AUTH_READY,
  AUTH_ERROR
};

volatile AuthState authState = AUTH_IDLE;

// IMPORTANT:
// Never call BLE writeValue() from the notify callback.
// The ESP32 BLE stack can deadlock because writeValue waits for a GATT event
// while the GATT callback that should release it is still running.
enum PendingTx {
  TX_NONE,
  TX_PING,
  TX_PAIR
};

volatile PendingTx pendingTx = TX_NONE;

unsigned long authLastSend = 0;
unsigned long readySince = 0;

// only one telemetry request at a time
bool telemetryWaiting = false;
unsigned long telemetrySentAt = 0;
unsigned long lastTelemetry = 0;
uint8_t telemetryStep = 0;

// DPC register 0x76 setup/verification. Used only after AUTH_READY.
enum DpcState {
  DPC_IDLE,
  DPC_NEED_WRITE,
  DPC_WAIT_SETTLE,
  DPC_WAIT_READBACK,
  DPC_CONFIRMED,
  DPC_FAILED
};
static DpcState dpcState = DPC_IDLE;
static uint8_t dpcAttempts = 0;
static unsigned long dpcLastAction = 0;
static unsigned long dpcLastPeriodicCheck = 0;
static const uint8_t DPC_MAX_ATTEMPTS = 5;

uint16_t odoLow = 0;
uint16_t odoHigh = 0;
bool haveOdoLow = false;
bool haveOdoHigh = false;

// ============================================================
// Dashboard-facing telemetry snapshot
// ============================================================

static NinebotTelemetrySnapshot telemetrySnapshot;
static portMUX_TYPE telemetryMux = portMUX_INITIALIZER_UNLOCKED;

static void resetTelemetrySnapshot() {
  portENTER_CRITICAL(&telemetryMux);
  telemetrySnapshot.speed_kmh = NAN;
  telemetrySnapshot.battery_percent = NAN;
  telemetrySnapshot.voltage_v = NAN;
  telemetrySnapshot.battery_current_a = NAN;
  telemetrySnapshot.bms_temp_c = NAN;
  telemetrySnapshot.odometer_km = NAN;
  telemetrySnapshot.ride_mode = -1;
  telemetrySnapshot.headlight_on = false;
  telemetrySnapshot.headlight_valid = false;
  telemetrySnapshot.connected = false;
  telemetrySnapshot.ready = false;
  telemetrySnapshot.last_update_ms = 0;
  telemetrySnapshot.sequence = 0;
  portEXIT_CRITICAL(&telemetryMux);
}

static void telemetrySetLink(bool connected, bool ready) {
  portENTER_CRITICAL(&telemetryMux);
  telemetrySnapshot.connected = connected;
  telemetrySnapshot.ready = ready;
  telemetrySnapshot.sequence++;
  portEXIT_CRITICAL(&telemetryMux);
}

static void telemetryClearMeasurements(bool connected) {
  portENTER_CRITICAL(&telemetryMux);
  telemetrySnapshot.speed_kmh = NAN;
  telemetrySnapshot.battery_percent = NAN;
  telemetrySnapshot.voltage_v = NAN;
  telemetrySnapshot.battery_current_a = NAN;
  telemetrySnapshot.bms_temp_c = NAN;
  telemetrySnapshot.odometer_km = NAN;
  telemetrySnapshot.ride_mode = -1;
  telemetrySnapshot.headlight_on = false;
  telemetrySnapshot.headlight_valid = false;
  telemetrySnapshot.connected = connected;
  telemetrySnapshot.ready = false;
  telemetrySnapshot.last_update_ms = 0;
  telemetrySnapshot.sequence++;
  portEXIT_CRITICAL(&telemetryMux);
}


// ============================================================
// RX reassembly
// ============================================================

uint8_t rxBuffer[192];
size_t rxLen = 0;
size_t rxExpected = 0;

// ============================================================
// Debug helpers
// ============================================================

void dumpHex(const char* prefix, const uint8_t* data, size_t len) {
  Serial.print(prefix);

  for (size_t i = 0; i < len; ++i) {
    if (data[i] < 0x10) Serial.print('0');
    Serial.print(data[i], HEX);

    if (i + 1 < len) Serial.print(' ');
  }

  Serial.println();
}

const char* stateName(AuthState s) {
  switch (s) {
    case AUTH_IDLE:      return "IDLE";
    case AUTH_WAIT_INIT: return "WAIT_INIT";
    case AUTH_WAIT_PING: return "WAIT_PING";
    case AUTH_WAIT_PAIR: return "WAIT_PAIR";
    case AUTH_READY:     return "READY";
    case AUTH_ERROR:     return "ERROR";
    default:             return "?";
  }
}

// ============================================================
// SHA1 / AES helpers
// ============================================================

bool aes128EcbEncrypt(const uint8_t key[16],
                      const uint8_t in[16],
                      uint8_t out[16]) {
  mbedtls_aes_context ctx;
  mbedtls_aes_init(&ctx);

  int rc = mbedtls_aes_setkey_enc(&ctx, key, 128);

  if (rc == 0) {
    rc = mbedtls_aes_crypt_ecb(
      &ctx,
      MBEDTLS_AES_ENCRYPT,
      in,
      out
    );
  }

  mbedtls_aes_free(&ctx);
  return rc == 0;
}

void calcSha1Key(const uint8_t data1[16], const uint8_t data2[16]) {
  uint8_t input[32];
  uint8_t hash[20];

  memcpy(input,      data1, 16);
  memcpy(input + 16, data2, 16);

  mbedtls_sha1_context ctx;
  mbedtls_sha1_init(&ctx);
  mbedtls_sha1_starts_ret(&ctx);
  mbedtls_sha1_update_ret(&ctx, input, sizeof(input));
  mbedtls_sha1_finish_ret(&ctx, hash);
  mbedtls_sha1_free(&ctx);

  memcpy(shaKey, hash, 16);
}

// ============================================================
// NinebotCrypto: CryptoFirst
// Same keystream for each 16-byte block.
// ============================================================

bool cryptoFirst(const uint8_t* in, uint8_t* out, size_t len) {
  uint8_t stream[16];

  if (!aes128EcbEncrypt(shaKey, FW_DATA, stream)) {
    return false;
  }

  for (size_t i = 0; i < len; ++i) {
    out[i] = in[i] ^ stream[i % 16];
  }

  return true;
}

// ============================================================
// NinebotCrypto: CryptoNext
// ============================================================

bool cryptoNext(const uint8_t* in,
                uint8_t* out,
                size_t len,
                uint32_t counter) {
  uint8_t aesEncData[16] = {0};

  aesEncData[0] = 1;
  aesEncData[1] = (uint8_t)((counter >> 24) & 0xFF);
  aesEncData[2] = (uint8_t)((counter >> 16) & 0xFF);
  aesEncData[3] = (uint8_t)((counter >>  8) & 0xFF);
  aesEncData[4] = (uint8_t)( counter        & 0xFF);

  // Protocol uses first 8 bytes of BLE random data here
  memcpy(aesEncData + 5, randomBleData, 8);

  aesEncData[15] = 0;

  size_t remaining = len;
  size_t offset = 0;

  while (remaining > 0) {
    aesEncData[15]++;

    uint8_t stream[16];
    if (!aes128EcbEncrypt(shaKey, aesEncData, stream)) {
      return false;
    }

    size_t blockLen = remaining <= 16 ? remaining : 16;

    for (size_t i = 0; i < blockLen; ++i) {
      out[offset + i] = in[offset + i] ^ stream[i];
    }

    remaining -= blockLen;
    offset += blockLen;
  }

  return true;
}

// ============================================================
// CRC First
// ============================================================

void calcCrcFirst(const uint8_t* payload,
                  size_t payloadLen,
                  uint8_t crcOut[2]) {
  uint32_t sum = 0;

  for (size_t i = 0; i < payloadLen; ++i) {
    sum += payload[i];
  }

  uint16_t crc = (uint16_t)(~sum);

  crcOut[0] = crc & 0xFF;
  crcOut[1] = (crc >> 8) & 0xFF;
}

// ============================================================
// CRC Next
// Independent implementation of the chained 4-byte authenticator.
// ============================================================

bool calcCrcNext(const uint8_t* plain,
                 size_t plainLen,
                 uint32_t counter,
                 uint8_t crcOut[4]) {
  if (plainLen < 3) return false;

  const size_t payloadLen = plainLen - 3;

  uint8_t aesEncData[16] = {0};
  aesEncData[0] = 89;
  aesEncData[1] = (uint8_t)((counter >> 24) & 0xFF);
  aesEncData[2] = (uint8_t)((counter >> 16) & 0xFF);
  aesEncData[3] = (uint8_t)((counter >>  8) & 0xFF);
  aesEncData[4] = (uint8_t)( counter        & 0xFF);

  memcpy(aesEncData + 5, randomBleData, 8);
  aesEncData[15] = (uint8_t)payloadLen;

  uint8_t chain[16];
  if (!aes128EcbEncrypt(shaKey, aesEncData, chain)) {
    return false;
  }

  // Mix 3-byte clear header into CBC-MAC chain
  uint8_t block[16] = {0};

  block[0] = plain[0] ^ chain[0];
  block[1] = plain[1] ^ chain[1];
  block[2] = plain[2] ^ chain[2];

  for (int i = 3; i < 16; ++i) {
    block[i] = chain[i];
  }

  if (!aes128EcbEncrypt(shaKey, block, chain)) {
    return false;
  }

  // Mix plaintext payload in blocks
  size_t remaining = payloadLen;
  size_t offset = 3;

  while (remaining > 0) {
    size_t blockLen = remaining <= 16 ? remaining : 16;

    memset(block, 0, sizeof(block));

    for (size_t i = 0; i < blockLen; ++i) {
      block[i] = plain[offset + i];
    }

    for (int i = 0; i < 16; ++i) {
      block[i] ^= chain[i];
    }

    if (!aes128EcbEncrypt(shaKey, block, chain)) {
      return false;
    }

    remaining -= blockLen;
    offset += blockLen;
  }

  // Final mask
  memset(aesEncData, 0, sizeof(aesEncData));

  aesEncData[0] = 1;
  aesEncData[1] = (uint8_t)((counter >> 24) & 0xFF);
  aesEncData[2] = (uint8_t)((counter >> 16) & 0xFF);
  aesEncData[3] = (uint8_t)((counter >>  8) & 0xFF);
  aesEncData[4] = (uint8_t)( counter        & 0xFF);

  memcpy(aesEncData + 5, randomBleData, 8);
  aesEncData[15] = 0;

  uint8_t mask[16];

  if (!aes128EcbEncrypt(shaKey, aesEncData, mask)) {
    return false;
  }

  for (int i = 0; i < 4; ++i) {
    crcOut[i] = mask[i] ^ chain[i];
  }

  return true;
}

// ============================================================
// Encrypt complete Ninebot packet
//
// Plain packet:
//   5A A5 LEN SRC DST CMD ARG DATA...
//
// Output:
//   clear header 3 bytes +
//   encrypted bytes from SRC onward +
//   six crypto trailer bytes
// ============================================================

size_t encryptPacket(const uint8_t* plain,
                     size_t plainLen,
                     uint8_t* out,
                     size_t outMax) {
  if (plainLen < 7) return 0;

  const size_t payloadLen = plainLen - 3;
  const size_t encLen = plainLen + 6;

  if (outMax < encLen) return 0;

  out[0] = plain[0];
  out[1] = plain[1];
  out[2] = plain[2];

  if (msgIt == 0) {
    uint8_t crc[2];

    calcCrcFirst(plain + 3, payloadLen, crc);

    if (!cryptoFirst(plain + 3, out + 3, payloadLen)) {
      return 0;
    }

    out[payloadLen + 3] = 0x00;
    out[payloadLen + 4] = 0x00;
    out[payloadLen + 5] = crc[0];
    out[payloadLen + 6] = crc[1];
    out[payloadLen + 7] = 0x00;
    out[payloadLen + 8] = 0x00;

    msgIt++;
  } else {
    msgIt++;

    uint8_t crc[4];

    if (!calcCrcNext(plain, plainLen, msgIt, crc)) {
      return 0;
    }

    if (!cryptoNext(plain + 3, out + 3, payloadLen, msgIt)) {
      return 0;
    }

    out[payloadLen + 3] = crc[0];
    out[payloadLen + 4] = crc[1];
    out[payloadLen + 5] = crc[2];
    out[payloadLen + 6] = crc[3];

    out[payloadLen + 7] = (uint8_t)((msgIt >> 8) & 0xFF);
    out[payloadLen + 8] = (uint8_t)( msgIt       & 0xFF);
  }

  // remember app random when sending 5C
  if (plainLen >= 23 &&
      plain[0] == 0x5A &&
      plain[1] == 0xA5 &&
      plain[2] == 0x10 &&
      plain[3] == DEV_PHONE &&
      plain[4] == DEV_BLE &&
      plain[5] == CMD_PING &&
      plain[6] == 0x00) {
    memcpy(randomAppData, plain + 7, 16);
    haveAppKey = true;
  }

  return encLen;
}

// ============================================================
// Decrypt complete encrypted Ninebot frame
// ============================================================

size_t decryptPacket(const uint8_t* enc,
                     size_t encLen,
                     uint8_t* plain,
                     size_t plainMax,
                     uint32_t& packetCounter) {
  if (encLen < 13) return 0;
  if (enc[0] != 0x5A || enc[1] != 0xA5) return 0;

  const size_t payloadLen = encLen - 9;
  const size_t plainLen = encLen - 6;

  if (plainMax < plainLen) return 0;

  plain[0] = enc[0];
  plain[1] = enc[1];
  plain[2] = enc[2];

  uint32_t newMsgIt = msgIt;

  if ((newMsgIt & 0x00008000UL) > 0 &&
      ((enc[encLen - 2] >> 7) == 0)) {
    newMsgIt += 0x00010000UL;
  }

  newMsgIt =
      (newMsgIt & 0xFFFF0000UL) +
      ((uint32_t)enc[encLen - 2] << 8) +
      (uint32_t)enc[encLen - 1];

  packetCounter = newMsgIt;

  if (newMsgIt == 0) {
    if (!cryptoFirst(enc + 3, plain + 3, payloadLen)) {
      return 0;
    }

    // Initial 0x5B reply contains BLE random + serial
    if (plainLen >= 37 &&
        plain[2] == 0x1E &&
        plain[3] == DEV_BLE &&
        plain[4] == DEV_PHONE &&
        plain[5] == CMD_INIT) {

      memcpy(randomBleData, plain + 7, 16);
      memcpy(scooterSerial, plain + 23, 14);

      // New stage key = SHA1(name16 || randomBleData)
      calcSha1Key(scooterName16, randomBleData);

      haveInitData = true;
    }
  }
  else if (newMsgIt > msgIt) {
    if (!cryptoNext(enc + 3, plain + 3, payloadLen, newMsgIt)) {
      return 0;
    }

    // 5C01 switches to SHA1(appRandom || bleRandom)
    if (plainLen >= 7 &&
        plain[2] == 0x00 &&
        plain[3] == DEV_BLE &&
        plain[4] == DEV_PHONE &&
        plain[5] == CMD_PING &&
        plain[6] == 0x01 &&
        haveAppKey) {

      calcSha1Key(randomAppData, randomBleData);
      Serial.println("Crypto-Key auf APP_KEY + BLE_KEY umgeschaltet.");
    }

    msgIt = newMsgIt;
  }
  else {
    // Equal counters can occur for a late/duplicate reply while 0x5C is being
    // retried. It is stale, not a fatal crypto error; ignore it quietly unless
    // packet debugging is enabled. Older counters remain worth warning about.
    if (newMsgIt == msgIt) {
      if (NB_PACKET_DEBUG) {
        Serial.printf("RX duplicate/stale counter %lu ignored.\n", (unsigned long)newMsgIt);
      }
    } else {
      Serial.printf(
        "WARN: RX Counter %lu ist kleiner als lokaler Counter %lu; Paket ignoriert.\n",
        (unsigned long)newMsgIt,
        (unsigned long)msgIt
      );
    }
    return 0;
  }

  return plainLen;
}

// ============================================================
// BLE send: ALWAYS write with response.
// Fragment to 20-byte BLE UART chunks.
// ============================================================

bool bleWriteFrame(const uint8_t* data, size_t len) {
  if (!pWriteChar || !isConnected) return false;

  if (NB_PACKET_DEBUG) {
    Serial.printf("BLE TX encrypted (%u B), msgIt=%lu\n", (unsigned)len, (unsigned long)msgIt);
    dumpHex("TX ENC: ", data, len);
  }

  // Nordic UART on this scooter uses ATT MTU 23 -> 20 payload bytes.
  // IMPORTANT: this function is only called from loop()/normal task context,
  // never from notifyCallback().
  size_t offset = 0;

  while (offset < len) {
    size_t chunk = len - offset;
    if (chunk > 20) chunk = 20;

    if (NB_PACKET_DEBUG) Serial.printf("  TX chunk %u..%u WITH response\n",
                                      (unsigned)offset, (unsigned)(offset + chunk - 1));

    pWriteChar->writeValue(
      (uint8_t*)(data + offset),
      chunk,
      true
    );

    if (NB_PACKET_DEBUG) Serial.println("  writeValue -> gesendet");

    offset += chunk;
    if (offset < len) delay(5);
  }

  return true;
}

// ============================================================
// Generic plain packet builder + encrypted sender
// ============================================================

bool sendNinebotPacket(uint8_t dst,
                       uint8_t cmd,
                       uint8_t arg,
                       const uint8_t* data,
                       uint8_t dataLen) {
  uint8_t plain[96];
  uint8_t enc[112];

  const size_t plainLen = 7 + dataLen;

  plain[0] = 0x5A;
  plain[1] = 0xA5;
  plain[2] = dataLen;
  plain[3] = DEV_PHONE;
  plain[4] = dst;
  plain[5] = cmd;
  plain[6] = arg;

  if (dataLen > 0 && data) {
    memcpy(plain + 7, data, dataLen);
  }

  if (NB_PACKET_DEBUG) { Serial.println(); dumpHex("TX PLAIN: ", plain, plainLen); }

  size_t encLen = encryptPacket(
    plain,
    plainLen,
    enc,
    sizeof(enc)
  );

  if (encLen == 0) {
    Serial.println("FEHLER: encryptPacket() fehlgeschlagen.");
    return false;
  }

  return bleWriteFrame(enc, encLen);
}

// ============================================================
// Authentication messages
// ============================================================

void createAppKey() {
  for (int i = 0; i < 16; ++i) {
    randomAppData[i] = (uint8_t)(esp_random() & 0xFF);
  }

  haveAppKey = true;
  usingStoredAppKey = false;

  dumpHex("APP random/key: ", randomAppData, 16);
}

void sendInit() {
  Serial.println();
  Serial.println("=== AUTH 1/3: INIT 0x5B ===");

  authState = AUTH_WAIT_INIT;
  authLastSend = millis();

  sendNinebotPacket(
    DEV_BLE,
    CMD_INIT,
    0x00,
    nullptr,
    0
  );
}

void sendPing() {
  Serial.println();
  Serial.println("=== AUTH 2/3: PING 0x5C ===");

  authState = AUTH_WAIT_PING;
  authLastSend = millis();

  sendNinebotPacket(
    DEV_BLE,
    CMD_PING,
    0x00,
    randomAppData,
    16
  );
}

void sendPair() {
  Serial.println();
  Serial.println("=== AUTH 3/3: PAIR 0x5D ===");

  authState = AUTH_WAIT_PAIR;
  authLastSend = millis();

  sendNinebotPacket(
    DEV_BLE,
    CMD_PAIR,
    0x00,
    scooterSerial,
    14
  );
}

// ============================================================
// Telemetry read
// ============================================================

void sendRead(uint8_t target, uint8_t reg, uint8_t readLen) {
  uint8_t payload[1] = { readLen };

  telemetryWaiting = true;
  telemetrySentAt = millis();

  sendNinebotPacket(
    target,
    CMD_READ,
    reg,
    payload,
    1
  );
}

static bool sendDpcOn() {
  // Equivalent clear payload before NinebotCrypto:
  //   5A A5 02 3E 20 03 76 01 00
  // The raw legacy CRC bytes 25 FF are not appended here. encryptPacket()
  // supplies the authenticated trailer required by the active BLE session.
  const uint8_t value[2] = { 0x01, 0x00 };
  Serial.println();
  Serial.println("=== DPC: setze ESC 0x76 = 0x0001 ===");
  return sendNinebotPacket(DEV_ESC, CMD_WRITE, REG_DPC, value, sizeof(value));
}

uint32_t littleEndianValue(const uint8_t* data, size_t len) {
  uint32_t value = 0;

  if (len > 4) len = 4;

  for (size_t i = 0; i < len; ++i) {
    value |= ((uint32_t)data[i]) << (8 * i);
  }

  return value;
}

void handleTelemetryReply(const uint8_t* plain, size_t len) {
  if (len < 7) return;

  const uint8_t src = plain[3];
  const uint8_t dst = plain[4];
  const uint8_t cmd = plain[5];
  const uint8_t reg = plain[6];
  const uint8_t dataLen = plain[2];

  if (dst != DEV_PHONE || cmd != CMD_READ_ACK) return;
  if (len < 7 + dataLen) return;

  const uint8_t* data = plain + 7;
  telemetryWaiting = false;

  if (src == DEV_ESC && reg == REG_DPC && dataLen >= 2) {
    uint16_t raw = (uint16_t)littleEndianValue(data, 2);
    Serial.printf(">>> DPC READBACK 0x76 = 0x%04X (%u)\n", (unsigned)raw, (unsigned)raw);

    if (raw == 1) {
      dpcState = DPC_CONFIRMED;
      dpcAttempts = 0;
      Serial.println("*** DPC 0x76 bestaetigt: EIN ***");
    } else if (dpcAttempts < DPC_MAX_ATTEMPTS) {
      dpcState = DPC_NEED_WRITE;
      dpcLastAction = millis();
      Serial.println("DPC ist noch nicht 1 -> setze erneut.");
    } else {
      dpcState = DPC_FAILED;
      Serial.println("WARN: DPC 0x76 nach 5 Versuchen nicht bestaetigt; Telemetrie laeuft weiter.");
    }
    return;
  }

  if (src == DEV_ESC && reg == REG_MODE && dataLen >= 2) {
    uint16_t raw = (uint16_t)littleEndianValue(data, 2);
    int8_t mode = -1;

    // Ninebot current-operation mode (0x1F):
    //   0 = NORMAL/Drive, 1 = ECO, 2 = SPORT
    if (raw <= 2) mode = (int8_t)raw;

    if (NB_TELEMETRY_DEBUG) Serial.printf(">>> DRIVE MODE raw=%u -> %s\n",
                  (unsigned)raw,
                  mode == 0 ? "DRIVE" : mode == 1 ? "ECO" : mode == 2 ? "SPORT" : "UNKNOWN");

    portENTER_CRITICAL(&telemetryMux);
    telemetrySnapshot.ride_mode = mode;
    telemetrySnapshot.last_update_ms = millis();
    telemetrySnapshot.sequence++;
    portEXIT_CRITICAL(&telemetryMux);
    return;
  }

  if (src == DEV_ESC && reg == REG_SPEED && dataLen >= 2) {
    int16_t raw = (int16_t)littleEndianValue(data, 2);
    float value = raw / 10.0f;
    if (NB_TELEMETRY_DEBUG) Serial.printf(">>> SPEED: %.1f km/h\n", value);
    portENTER_CRITICAL(&telemetryMux);
    telemetrySnapshot.speed_kmh = value;
    telemetrySnapshot.last_update_ms = millis();
    telemetrySnapshot.sequence++;
    portEXIT_CRITICAL(&telemetryMux);
    return;
  }

  if (src == DEV_ESC && reg == REG_ODO_LO && dataLen >= 2) {
    odoLow = (uint16_t)littleEndianValue(data, 2);
    haveOdoLow = true;

    if (haveOdoHigh) {
      uint32_t metres = ((uint32_t)odoHigh << 16) | odoLow;
      float value = metres / 1000.0f;
      if (NB_TELEMETRY_DEBUG) Serial.printf(">>> ODO: %.3f km\n", value);
      portENTER_CRITICAL(&telemetryMux);
      telemetrySnapshot.odometer_km = value;
      telemetrySnapshot.last_update_ms = millis();
      telemetrySnapshot.sequence++;
      portEXIT_CRITICAL(&telemetryMux);
    }
    return;
  }

  if (src == DEV_ESC && reg == REG_ODO_HI && dataLen >= 2) {
    odoHigh = (uint16_t)littleEndianValue(data, 2);
    haveOdoHigh = true;

    if (haveOdoLow) {
      uint32_t metres = ((uint32_t)odoHigh << 16) | odoLow;
      float value = metres / 1000.0f;
      if (NB_TELEMETRY_DEBUG) Serial.printf(">>> ODO: %.3f km\n", value);
      portENTER_CRITICAL(&telemetryMux);
      telemetrySnapshot.odometer_km = value;
      telemetrySnapshot.last_update_ms = millis();
      telemetrySnapshot.sequence++;
      portEXIT_CRITICAL(&telemetryMux);
    }
    return;
  }

  if (src == DEV_BATT && reg == REG_BAT_PCT && dataLen >= 2) {
    uint16_t pct = (uint16_t)littleEndianValue(data, 2);
    if (NB_TELEMETRY_DEBUG) Serial.printf(">>> AKKU: %u %%\n", (unsigned)pct);
    portENTER_CRITICAL(&telemetryMux);
    telemetrySnapshot.battery_percent = (float)pct;
    telemetrySnapshot.last_update_ms = millis();
    telemetrySnapshot.sequence++;
    portEXIT_CRITICAL(&telemetryMux);
    return;
  }

  if (src == DEV_BATT && reg == REG_BAT_CUR && dataLen >= 2) {
    int16_t raw = (int16_t)littleEndianValue(data, 2);
    float value = raw / 100.0f;
    if (NB_TELEMETRY_DEBUG) Serial.printf(">>> BAT CURRENT: %.2f A\n", value);
    portENTER_CRITICAL(&telemetryMux);
    telemetrySnapshot.battery_current_a = value;
    telemetrySnapshot.last_update_ms = millis();
    telemetrySnapshot.sequence++;
    portEXIT_CRITICAL(&telemetryMux);
    return;
  }

  if (src == DEV_BATT && reg == REG_BAT_VOLT && dataLen >= 2) {
    uint16_t raw = (uint16_t)littleEndianValue(data, 2);
    float value = raw / 100.0f;
    if (NB_TELEMETRY_DEBUG) Serial.printf(">>> BAT VOLTAGE: %.2f V\n", value);
    portENTER_CRITICAL(&telemetryMux);
    telemetrySnapshot.voltage_v = value;
    telemetrySnapshot.last_update_ms = millis();
    telemetrySnapshot.sequence++;
    portEXIT_CRITICAL(&telemetryMux);
    return;
  }

  if (src == DEV_BATT && reg == REG_BAT_TEMP && dataLen >= 2) {
    int t1 = (int)data[0] - 20;
    int t2 = (int)data[1] - 20;
    float value = (t1 + t2) * 0.5f;
    if (NB_TELEMETRY_DEBUG) Serial.printf(">>> BAT TEMP: %d / %d C\n", t1, t2);
    portENTER_CRITICAL(&telemetryMux);
    telemetrySnapshot.bms_temp_c = value;
    telemetrySnapshot.last_update_ms = millis();
    telemetrySnapshot.sequence++;
    portEXIT_CRITICAL(&telemetryMux);
    return;
  }

  Serial.printf(">>> READ src=0x%02X reg=0x%02X: ", src, reg);
  dumpHex("", data, dataLen);
}

// ============================================================
// Plain decrypted packet handler
// ============================================================

void handlePlainPacket(const uint8_t* plain,
                       size_t len,
                       uint32_t counter) {
  if (NB_PACKET_DEBUG) {
    Serial.println();
    Serial.printf("RX decrypted, counter=%lu, local msgIt=%lu\n",
                  (unsigned long)counter, (unsigned long)msgIt);
    dumpHex("RX PLAIN: ", plain, len);
  }

  if (len < 7) return;

  uint8_t src = plain[3];
  uint8_t dst = plain[4];
  uint8_t cmd = plain[5];
  uint8_t arg = plain[6];

  if (NB_PACKET_DEBUG) Serial.printf("SRC=0x%02X DST=0x%02X CMD=0x%02X ARG=0x%02X LEN=%u\n",
                                    src,dst,cmd,arg,plain[2]);

  // Passive G30 dashboard-status frame. On the internal Ninebot bus the ESC
  // sends command 0x64 to the BLE/dashboard board; byte 9 is the headlight
  // state (0/1). Some BLE firmwares forward this frame to the phone session,
  // others do not. When we see it, use it without sending any extra command.
  if (src == DEV_ESC && dst == DEV_BLE && cmd == 0x64 && len >= 13 && plain[2] >= 6) {
    const bool light = plain[9] != 0;
    Serial.printf(">>> DASH LIGHT: %s (passive 0x64)\n", light ? "ON" : "OFF");
    portENTER_CRITICAL(&telemetryMux);
    telemetrySnapshot.headlight_on = light;
    telemetrySnapshot.headlight_valid = true;
    telemetrySnapshot.sequence++;
    portEXIT_CRITICAL(&telemetryMux);
    return;
  }

  // ----------------------------------------------------------
  // INIT response
  // ----------------------------------------------------------
  if (src == DEV_BLE &&
      dst == DEV_PHONE &&
      cmd == CMD_INIT &&
      haveInitData) {

    Serial.println();
    Serial.println("*** NinebotCrypto INIT OK ***");

    dumpHex("BLE random/key: ", randomBleData, 16);

    char serialText[15] = {0};
    memcpy(serialText, scooterSerial, 14);

    Serial.print("Scooter S/N: ");
    Serial.println(serialText);

    Serial.printf("0x5B ARG = 0x%02X\n", arg);

    // v7.14 auto-auth priority:
    // 1) Explicit real Segway app key, if provisioned.
    // 2) Our own key from the last SUCCESSFUL button pairing with this exact
    //    scooter serial. Try it exactly like a bound app: no 0x5C, direct 0x5D.
    // 3) Fresh-key + one-time button pairing fallback.
    if (haveSegwayAppKey && !segwayKeyRejectedThisBoot) {
      memcpy(randomAppData, segwayAppKey, sizeof(randomAppData));
      haveAppKey = true;
      usingStoredAppKey = false;
      directSegwayAuth = true;
      directStoredAuth = false;
      pairRetryCount = 0;
      calcSha1Key(randomAppData, randomBleData);
      Serial.println("[AUTH-APP] Echter Segway-App-Key -> direkter 0x5D-Login ohne 0x5C/Powerbutton.");
      authState = AUTH_WAIT_PAIR;
      authLastSend = millis();
      pendingTx = TX_PAIR;
    } else if (!storedKeyRejectedThisBoot && loadStoredAppKeyForScooter()) {
      directSegwayAuth = false;
      directStoredAuth = true;
      pairRetryCount = 0;
      calcSha1Key(randomAppData, randomBleData);
      Serial.println("[AUTH-AUTO] Gebundener Dashboard-Key -> direkter 0x5D-Reconnect ohne 0x5C/Powerbutton.");
      authState = AUTH_WAIT_PAIR;
      authLastSend = millis();
      pendingTx = TX_PAIR;
    } else {
      usingStoredAppKey = false;
      directSegwayAuth = false;
      directStoredAuth = false;
      Serial.println("[AUTH] Noch kein akzeptierter Reconnect-Key -> frischer 0x3E-Key; Powerbutton einmalig noetig.");
      createAppKey();
      Serial.println("Plane 0x5C ausserhalb des Notify-Callbacks ein.");
      authState = AUTH_WAIT_PING;
      authLastSend = millis();
      pendingTx = TX_PING;
    }

    return;
  }

  // ----------------------------------------------------------
  // PING/AUTH response
  // ----------------------------------------------------------
  if (src == DEV_BLE &&
      dst == DEV_PHONE &&
      cmd == CMD_PING) {

    if (arg == 0x01) {
      Serial.println();
      Serial.println("*** 0x5C01: Power/Auth bestaetigt ***");
      Serial.println("Plane 0x5D ausserhalb des Notify-Callbacks ein.");

      authState = AUTH_WAIT_PAIR;
      authLastSend = millis();
      pendingTx = TX_PAIR;
    }
    else {
      Serial.println();
      Serial.println("*** 0x5C00: Scooter wartet auf Pairing-Bestaetigung. ***");
      if (usingStoredAppKey) {
        Serial.println("[AUTH-NVS] Gespeicherter Key wurde erkannt, Scooter verlangt aber erneut physische Bestaetigung.");
      }
      Serial.println(">>> Power-Taste am Scooter kurz druecken, falls 0x5C00 bestehen bleibt. <<<");
      Serial.println("0x5C wird bis zur Bestaetigung erneut gesendet.");

      authState = AUTH_WAIT_PING;
      authLastSend = millis();
    }

    return;
  }

  // ----------------------------------------------------------
  // PAIR response
  // ----------------------------------------------------------
  if (src == DEV_BLE &&
      dst == DEV_PHONE &&
      cmd == CMD_PAIR) {

    if (arg == 0x01) {
      authState = AUTH_READY;
      readySince = millis();
      telemetrySetLink(true, true);

      if (foundDevice && foundDevice->haveName()) {
        saveBoundScooterTargetName(foundDevice->getName().c_str());
      }

      // A fresh button pairing that reaches 0x5D01 has proven that THIS key was
      // accepted by the scooter. Persist it for the next boot and try it as a
      // bound direct-PAIR credential before asking for the button again.
      if (!directSegwayAuth && !directStoredAuth) {
        saveStoredAppKeyForScooter();
        Serial.println("[AUTH-AUTO] Erstpairing akzeptiert; naechster Start versucht Auto-Auth ohne Powerbutton.");
      } else if (directStoredAuth) {
        Serial.println("[AUTH-AUTO] AUTO-AUTH ERFOLGREICH: gespeicherter Dashboard-Key akzeptiert, kein Powerbutton.");
      } else if (directSegwayAuth) {
        Serial.println("[AUTH-APP] Direkter 0x5D-Login akzeptiert: buttonlose Auth aktiv.");
      }

      Serial.println();
      Serial.println("==============================================");
      Serial.println("*** AUTHENTIFIZIERUNG ERFOLGREICH - READY ***");
      Serial.println("==============================================");
      Serial.println("Auth READY. Setze und pruefe DPC-Register 0x76, danach startet Telemetrie ...");

      telemetryWaiting = false;
      lastTelemetry = 0;
      telemetryStep = 0;
      dpcAttempts = 0;
      dpcLastAction = 0;
      dpcLastPeriodicCheck = millis();
      dpcState = DPC_NEED_WRITE;
    }
    else {
      if (directSegwayAuth) {
        Serial.printf("[AUTH-APP] Direkter 0x5D-Login abgelehnt (ARG=0x%02X) -> Button-Fallback.\n", arg);
        segwayKeyRejectedThisBoot = true;
        directSegwayAuth = false;
        pClient->disconnect();
      } else if (directStoredAuth) {
        Serial.printf("[AUTH-AUTO] Gespeicherter Dashboard-Key abgelehnt (ARG=0x%02X) -> loesche Key und paare einmal neu.\n", arg);
        storedKeyRejectedThisBoot = true;
        clearStoredAppKeyForScooter();
        pClient->disconnect();
      } else {
        Serial.printf("PAIR Antwort ARG=0x%02X; versuche erneut.\n", arg);
        authState = AUTH_WAIT_PAIR;
        authLastSend = millis();
      }
    }

    return;
  }

  // ----------------------------------------------------------
  // Telemetry
  // ----------------------------------------------------------
  handleTelemetryReply(plain, len);
}

// ============================================================
// Complete encrypted frame processor
// ============================================================

void processEncryptedFrame(const uint8_t* frame, size_t len) {
  if (NB_PACKET_DEBUG) { Serial.println(); dumpHex("RX ENC FULL: ", frame, len); }

  uint8_t plain[192];
  uint32_t counter = 0;

  size_t plainLen = decryptPacket(
    frame,
    len,
    plain,
    sizeof(plain),
    counter
  );

  if (plainLen == 0) {
    Serial.println("RX konnte nicht entschluesselt werden.");
    return;
  }

  handlePlainPacket(plain, plainLen, counter);
}

// ============================================================
// Notify callback + fragment reassembly
// ============================================================

void notifyCallback(BLERemoteCharacteristic* c,
                    uint8_t* data,
                    size_t length,
                    bool isNotify) {
  if (NB_PACKET_DEBUG) {
    Serial.printf("RX BLE chunk: %u B\n", (unsigned)length);
    dumpHex("  RX chunk: ", data, length);
  }

  // A new encrypted Ninebot packet starts with 5A A5
  if (length >= 2 &&
      data[0] == 0x5A &&
      data[1] == 0xA5) {

    rxLen = 0;
    rxExpected = 0;
  }

  if (rxLen + length > sizeof(rxBuffer)) {
    Serial.println("RX buffer overflow -> reset.");
    rxLen = 0;
    rxExpected = 0;
    return;
  }

  memcpy(rxBuffer + rxLen, data, length);
  rxLen += length;

  if (rxLen >= 3 && rxExpected == 0) {
    // encrypted total = dataLen + 13
    rxExpected = (size_t)rxBuffer[2] + 13;

    if (NB_PACKET_DEBUG) Serial.printf("RX erwartet insgesamt %u B\n", (unsigned)rxExpected);

    if (rxExpected > sizeof(rxBuffer)) {
      Serial.println("Unplausible RX-Laenge -> reset.");
      rxLen = 0;
      rxExpected = 0;
      return;
    }
  }

  if (rxExpected > 0 && rxLen >= rxExpected) {
    processEncryptedFrame(rxBuffer, rxExpected);

    size_t leftover = rxLen - rxExpected;

    if (leftover > 0) {
      memmove(
        rxBuffer,
        rxBuffer + rxExpected,
        leftover
      );
    }

    rxLen = leftover;
    rxExpected = 0;
  }
}

// ============================================================
// BLE callbacks
// ============================================================

class ClientCallbacks : public BLEClientCallbacks {
  void onConnect(BLEClient* c) override {
    isConnected = true;
    everConnectedThisBoot = true;
        telemetryClearMeasurements(true);
    Serial.println("BLE verbunden.");
  }

  void onDisconnect(BLEClient* c) override {
    isConnected = false;
    disconnectedAtMs = millis();
    clientCleanupPending = true;

    pWriteChar = nullptr;
    pNotifyChar = nullptr;

    authState = AUTH_IDLE;
    pendingTx = TX_NONE;

    telemetryWaiting = false;
    dpcState = DPC_IDLE;
    dpcAttempts = 0;
    dpcLastAction = 0;
    telemetrySetLink(false, false);

    rxLen = 0;
    rxExpected = 0;

    Serial.println("BLE getrennt.");
  }
};

class AdvertisedCallbacks : public BLEAdvertisedDeviceCallbacks {
  void onResult(BLEAdvertisedDevice d) override {
    bool nameOk = false;
    if (d.haveName()) {
      const std::string advName = d.getName();
      if (boundScooterName.length() > 0) {
        nameOk = (advName == boundScooterName.c_str());
      } else {
        nameOk = advName.rfind("NB", 0) == 0;
      }
    }

    bool serviceOk =
      d.haveServiceUUID() &&
      d.isAdvertisingService(SVC_UUID);

    // Do not accept arbitrary Nordic-UART devices. The user's setup also has
    // an ESP32-UART-Dashboard advertising the same UUID; require Ninebot name
    // AND service so we do not connect to ourselves/another UART bridge.
    if (nameOk && serviceOk) {
      scanFoundThisRound = true;
            Serial.print("Scooter gefunden: ");
      Serial.println(d.toString().c_str());

      BLEDevice::getScan()->stop();

      if (foundDevice) {
        delete foundDevice;
      }

      foundDevice = new BLEAdvertisedDevice(d);
      doConnect = true;
    }
  }
};

// Run the blocking BLE scan in a short-lived FreeRTOS task so the LVGL
// dashboard remains responsive while disconnected. Connection/auth writes
// still happen from ninebotTelemetryLoop(), never from a BLE callback.
static void scanTask(void* arg) {
  uint32_t seconds = (uint32_t)(uintptr_t)arg;
  scanFoundThisRound = false;
  Serial.printf("[BLE-SCAN] task start, stack=%u bytes, heap=%u\n", 12288U, (unsigned)ESP.getFreeHeap());
  BLEDevice::getScan()->start(seconds, false);
  Serial.printf("[BLE-SCAN] task done, heap=%u\n", (unsigned)ESP.getFreeHeap());
  BLEDevice::getScan()->clearResults();

  scanRunning = false;
  vTaskDelete(nullptr);
}

static bool startScanAsync(uint32_t seconds) {
  if (scanRunning) return true;
  scanRunning = true;

  BaseType_t ok = xTaskCreate(
    scanTask,
    "nb-scan",
    12288,
    (void*)(uintptr_t)seconds,
    1,
    nullptr
  );

  if (ok != pdPASS) {
    scanRunning = false;
    Serial.println("BLE Scan-Task konnte nicht gestartet werden.");
    return false;
  }
  return true;
}

// ============================================================
// Enable notifications
// ============================================================

void enableNotifications() {
  pNotifyChar->registerForNotify(notifyCallback);

  Serial.println("Notify callback registriert.");

  BLERemoteDescriptor* cccd =
    pNotifyChar->getDescriptor(CCCD_UUID);

  if (cccd) {
    uint8_t enable[2] = {0x01, 0x00};

    cccd->writeValue(
      enable,
      sizeof(enable),
      true
    );

    Serial.println("CCCD 0x2902 = 01 00.");
  }
  else {
    Serial.println(
      "CCCD 0x2902 nicht separat gefunden; registerForNotify aktiv."
    );
  }
}

// ============================================================
// Reset crypto session
// ============================================================

void resetCrypto(const std::string& name) {
  memset(scooterName16, 0, sizeof(scooterName16));
  memset(randomBleData, 0, sizeof(randomBleData));
  memset(randomAppData, 0, sizeof(randomAppData));
  memset(scooterSerial, 0, sizeof(scooterSerial));

  size_t n = name.length();
  if (n > 16) n = 16;

  memcpy(
    scooterName16,
    name.data(),
    n
  );

  calcSha1Key(
    scooterName16,
    FW_DATA
  );

  msgIt = 0;

  haveInitData = false;
  haveAppKey = false;
  usingStoredAppKey = false;
  directSegwayAuth = false;
  directStoredAuth = false;
  pairRetryCount = 0;
  pendingTx = TX_NONE;

  rxLen = 0;
  rxExpected = 0;

  dumpHex("Initial SHA1-Key: ", shaKey, 16);
}

// ============================================================
// Connect
// ============================================================

bool connectScooter() {
  if (!foundDevice) return false;

  pClient = BLEDevice::createClient();
  if (!pClient) {
    Serial.println("BLE Client konnte nicht erzeugt werden.");
    return false;
  }

  // Reuse one callback object instead of leaking a new callback on every reconnect.
  static ClientCallbacks clientCallbacks;
  pClient->setClientCallbacks(&clientCallbacks);

  if (!pClient->connect(foundDevice)) {
    Serial.println("BLE Connect fehlgeschlagen.");
    delete pClient;
    pClient = nullptr;
    return false;
  }

  BLERemoteService* svc =
    pClient->getService(SVC_UUID);

  if (!svc) {
    Serial.println("Nordic UART Service fehlt.");
    pClient->disconnect();
    return false;
  }

  pWriteChar =
    svc->getCharacteristic(CHR_WRITE);

  pNotifyChar =
    svc->getCharacteristic(CHR_NOTIFY);

  if (!pWriteChar || !pNotifyChar) {
    Serial.println("Write/Notify Characteristic fehlt.");
    pClient->disconnect();
    return false;
  }

  Serial.printf(
    "Write: write=%s writeNoResp=%s\n",
    pWriteChar->canWrite() ? "ja" : "nein",
    pWriteChar->canWriteNoResponse() ? "ja" : "nein"
  );

  Serial.printf(
    "Notify: notify=%s indicate=%s\n",
    pNotifyChar->canNotify() ? "ja" : "nein",
    pNotifyChar->canIndicate() ? "ja" : "nein"
  );

  enableNotifications();

  std::string name = foundDevice->getName();

  Serial.print("Crypto-Name: ");
  Serial.println(name.c_str());

  resetCrypto(name);

  delay(300);

  sendInit();

  return true;
}

// ============================================================
// Deferred TX
// ============================================================

void servicePendingTx() {
  if (!isConnected) return;

  PendingTx job = pendingTx;
  if (job == TX_NONE) return;

  // Clear BEFORE sending so a notification arriving during/after the write
  // cannot accidentally cause the same job to be sent twice.
  pendingTx = TX_NONE;

  switch (job) {
    case TX_PING:
      Serial.println();
      Serial.println("[deferred] Sende 0x5C jetzt aus loop().");
      sendPing();
      break;

    case TX_PAIR:
      Serial.println();
      Serial.println("[deferred] Sende 0x5D jetzt aus loop().");
      sendPair();
      break;

    default:
      break;
  }
}

// ============================================================
// Auth retry / telemetry scheduler
// ============================================================

void serviceAuth() {
  if (!isConnected) return;

  unsigned long now = millis();

  // If init reply was lost, retry from a fresh BLE session is safer
  // because the crypto iterator already advanced.
  if (authState == AUTH_WAIT_INIT &&
      now - authLastSend > 5000) {

    Serial.println();
    Serial.println("INIT Timeout -> trenne und starte Session neu.");

    pClient->disconnect();
    return;
  }

  // Re-send PING every second while waiting for power confirmation.
  // Note: every message uses the chained counter, as required.
  if (authState == AUTH_WAIT_PING &&
      now - authLastSend > 1000) {

    Serial.println(
      "Warte auf 0x5C01 / Power-Taste -> sende 0x5C erneut ..."
    );

    sendPing();
    return;
  }

  if (authState == AUTH_WAIT_PAIR &&
      now - authLastSend > 1500) {

    if (directSegwayAuth || directStoredAuth) {
      if (++pairRetryCount >= 2) {
        if (directStoredAuth) {
          Serial.println("[AUTH-AUTO] Direkter 0x5D-Reconnect ohne Antwort -> gespeicherten Key verwerfen und einmal neu pairen.");
          storedKeyRejectedThisBoot = true;
          clearStoredAppKeyForScooter();
          directStoredAuth = false;
        } else {
          Serial.println("[AUTH-APP] Direkter 0x5D-Login ohne Antwort -> Key nicht akzeptiert; starte sauberen Button-Fallback.");
          segwayKeyRejectedThisBoot = true;
          directSegwayAuth = false;
        }
        pClient->disconnect();
        return;
      }
      Serial.println(directStoredAuth
        ? "[AUTH-AUTO] Warte auf 0x5D01 -> ein letzter Auto-Auth-Retry ..."
        : "[AUTH-APP] Warte auf 0x5D01 -> ein letzter direkter 0x5D-Retry ...");
    } else {
      Serial.println("Warte auf 0x5D01 -> sende Pair erneut ...");
    }

    sendPair();
    return;
  }
}

static void serviceDpc() {
  if (!isConnected || authState != AUTH_READY) return;

  const unsigned long now = millis();

  switch (dpcState) {
    case DPC_NEED_WRITE:
      if (dpcAttempts >= DPC_MAX_ATTEMPTS) {
        dpcState = DPC_FAILED;
        Serial.println("WARN: DPC 0x76 konnte nicht bestaetigt werden; gebe nach 5 Versuchen auf.");
        return;
      }
      dpcAttempts++;
      Serial.printf("[DPC] Schreibversuch %u/%u\n", (unsigned)dpcAttempts, (unsigned)DPC_MAX_ATTEMPTS);
      if (sendDpcOn()) {
        dpcLastAction = now;
        dpcState = DPC_WAIT_SETTLE;
      } else {
        dpcLastAction = now;
      }
      return;

    case DPC_WAIT_SETTLE:
      if (now - dpcLastAction >= 150) {
        Serial.println("[DPC] Lese 0x76 zur Kontrolle ...");
        sendRead(DEV_ESC, REG_DPC, 2);
        dpcLastAction = now;
        dpcState = DPC_WAIT_READBACK;
      }
      return;

    case DPC_WAIT_READBACK:
      if (telemetryWaiting && now - telemetrySentAt > 800) {
        telemetryWaiting = false;
        Serial.println("[DPC] Readback Timeout -> setze erneut.");
        dpcState = DPC_NEED_WRITE;
        dpcLastAction = now;
      }
      return;

    case DPC_CONFIRMED:
    case DPC_FAILED:
    case DPC_IDLE:
    default:
      return;
  }
}

void serviceTelemetry() {
  if (!isConnected || authState != AUTH_READY) return;
  if (dpcState != DPC_CONFIRMED && dpcState != DPC_FAILED) return;

  unsigned long now = millis();

  if (telemetryWaiting) {
    if (now - telemetrySentAt > 800) {
      if (NB_TELEMETRY_DEBUG) Serial.println("Telemetry Timeout; fahre mit naechstem Register fort.");
      telemetryWaiting = false;
    } else {
      return;
    }
  }

  // One request at a time remains mandatory. 100 ms is only the minimum gap;
  // a slower GATT/notify round trip automatically throttles this loop.
  if (now - lastTelemetry < 100) return;
  lastTelemetry = now;

  // DPC needs only a slow watchdog, not a slot in every fast poll cycle.
  if (dpcState == DPC_CONFIRMED && now - dpcLastPeriodicCheck >= 30000) {
    dpcLastPeriodicCheck = now;
    sendRead(DEV_ESC, REG_DPC, 2);
    return;
  }

  struct Poll { uint8_t target, reg, len; };
  // Speed every second request (~5 Hz target). Battery current is frequent for
  // LOAD/REGEN; slow values share the remaining slots.
  static const Poll poll[] = {
    { DEV_ESC,  REG_SPEED,    2 }, { DEV_BATT, REG_BAT_CUR,  2 },
    { DEV_ESC,  REG_SPEED,    2 }, { DEV_BATT, REG_BAT_CUR,  2 },
    { DEV_ESC,  REG_SPEED,    2 }, { DEV_BATT, REG_BAT_VOLT, 2 },
    { DEV_ESC,  REG_SPEED,    2 }, { DEV_BATT, REG_BAT_CUR,  2 },
    { DEV_ESC,  REG_SPEED,    2 }, { DEV_BATT, REG_BAT_PCT,  2 },
    { DEV_ESC,  REG_SPEED,    2 }, { DEV_BATT, REG_BAT_CUR,  2 },
    { DEV_ESC,  REG_SPEED,    2 }, { DEV_ESC,  REG_MODE,     2 },
    { DEV_ESC,  REG_SPEED,    2 }, { DEV_BATT, REG_BAT_CUR,  2 },
    { DEV_ESC,  REG_SPEED,    2 }, { DEV_BATT, REG_BAT_TEMP, 2 },
    { DEV_ESC,  REG_SPEED,    2 }, { DEV_BATT, REG_BAT_CUR,  2 },
    { DEV_ESC,  REG_SPEED,    2 }, { DEV_ESC,  REG_ODO_LO,   2 },
    { DEV_ESC,  REG_SPEED,    2 }, { DEV_ESC,  REG_ODO_HI,   2 }
  };

  const size_t pollCount = sizeof(poll) / sizeof(poll[0]);
  const Poll &q = poll[telemetryStep];
  telemetryStep = (telemetryStep + 1) % pollCount;
  sendRead(q.target, q.reg, q.len);
}

// ============================================================
// Dashboard module API
// ============================================================

void ninebotTelemetryBegin() {
  resetTelemetrySnapshot();

  Serial.println();
  Serial.println("Ninebot G30 BLE Telemetry v7.14 / self-bound auto-auth + target autoconnect + fast telemetry + DPC verify");
  Serial.println("NinebotCrypto + one-time button bind then direct 0x5D auto-auth + 100ms scheduler");
  haveSegwayAppKey = loadSegwayAppKey();
  Serial.println(haveSegwayAppKey ? "[AUTH-APP] Segway-App-Key in NVS vorhanden." : "[AUTH-APP] Kein Segway-App-Key in NVS; Button-Fallback aktiv.");
  loadBoundScooterTarget();
  if (boundScooterName.length() > 0) {
    Serial.print("[AUTOCONNECT] Ziel aus NVS: ");
    Serial.println(boundScooterName);
  } else {
    Serial.println("[AUTOCONNECT] Noch kein Ziel gebunden; erster erfolgreich authentifizierter NBScooter wird gespeichert.");
  }
  Serial.println();

  Serial.printf("[BLE] vor BLEDevice::init, heap=%u\n", (unsigned)ESP.getFreeHeap());
  BLEDevice::init("");
  Serial.printf("[BLE] nach BLEDevice::init, heap=%u\n", (unsigned)ESP.getFreeHeap());

  BLEScan* scan = BLEDevice::getScan();
  scan->setAdvertisedDeviceCallbacks(new AdvertisedCallbacks());
  scan->setActiveScan(true);
  scan->setInterval(100);
  scan->setWindow(99);

  Serial.println("[AUTOCONNECT] Scanne nach Ziel-Scooter ...");
  startScanAsync(10);
}

void ninebotTelemetryLoop() {
  // Never destroy BLE objects from onDisconnect(). The callback runs inside the
  // BLE stack; cleanup here after it has returned. BLEClient's destructor also
  // unregisters the GATT client, which prevents stale clients accumulating.
  if (clientCleanupPending && !isConnected && !scanRunning) {
    if (pClient) {
      Serial.println("[BLE-RECOVER] Raeume getrennten BLEClient auf.");
      delete pClient;
      pClient = nullptr;
    }
    clientCleanupPending = false;
  }

  if (doConnect && !scanRunning) {
    doConnect = false;

    if (!connectScooter()) {
      delay(1000);
    }
  }

  // Keep all GATT writes in normal task/loop context, never in notifyCallback().
  servicePendingTx();
  serviceAuth();
  serviceDpc();
  serviceTelemetry();

  if (!isConnected &&
      !doConnect &&
      !scanRunning &&
      authState == AUTH_IDLE) {

    // Give the scooter and the controller a short moment to finish the previous
    // link teardown before scanning again. Immediate rescans are surprisingly
    // good at finding absolutely nothing.
    if (disconnectedAtMs != 0 &&
        (uint32_t)(millis() - disconnectedAtMs) < RECONNECT_SETTLE_MS) {
      return;
    }

    Serial.println("[AUTOCONNECT] Scooter offline/nicht sichtbar -> scanne weiter ...");
    startScanAsync(5);
  }
}

bool ninebotTelemetryGet(NinebotTelemetrySnapshot* out) {
  if (!out) return false;
  portENTER_CRITICAL(&telemetryMux);
  *out = telemetrySnapshot;
  portEXIT_CRITICAL(&telemetryMux);
  return true;
}
